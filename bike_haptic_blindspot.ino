// ============================================================================
//  BIKE BLIND-SPOT + SPEED/ODOMETRY HAPTIC SYSTEM  —  Arduino UNO build
// ============================================================================
//  - 2x HC-SR04 ultrasonic sensors  -> blind-spot detection (left / right)
//  - 1x Hall effect sensor (1 magnet on the front wheel) -> speed + distance
//  - 2x TacHammer / Drake haptic actuators via DRV2605 + TCA9548A I2C mux
//
//  BOARD: Arduino Uno (ATmega328P)
//
//  KEY DIFFERENCES vs the 32U4 version
//  ─────────────────────────────────────────────────────────────────────────
//  • Timer4 does not exist on the 328P.  Each DRV2605 now gets its OWN PWM
//    line from Timer2:  LEFT = OC2A = pin 11,  RIGHT = OC2B = pin 3.
//    Both run at ~7.8 kHz (prescaler /8, TOP = 255), within DRV2605 spec.
//  • Splitting the PWM per motor is what fixes the "both motors buzz at once"
//    problem: the I2C mux only switches control, not the drive signal, so a
//    single shared PWM pin always drove both. Now left/right are electrically
//    separate and setHaptic() writes only the targeted motor's register.
//  • PWM13 / OCR4A / TCCR4x / PLLFRQ are all gone (32U4-only).
//  • Hardware-interrupt pins on the 328P are D2 and D3 only.
//    HALL_PIN is set to 2 (INT0). D3 is now used by the RIGHT motor PWM,
//    so the Hall sensor must stay on D2.
//  • I2C on the Uno is A4 (SDA) / A5 (SCL) — keep those free.
//  • Ultrasonic and other signal pins are unchanged (4, 5, 8, 9).
// ============================================================================

#include <Wire.h>

// ============================================================================
// ============================ USER CONFIG ===================================
// ============================================================================

// ---- Pins ------------------------------------------------------------------
#define LEFT_TRIG_PIN    4
#define LEFT_ECHO_PIN    5
#define RIGHT_TRIG_PIN   8
#define RIGHT_ECHO_PIN   9

// Hall sensor: must be an interrupt-capable pin.
//   Uno (328P): D2 (INT0) or D3 (INT1).  I2C is on A4/A5 — no conflict.
#define HALL_PIN         2

// ---- Blind-spot (ultrasonic) parameters ------------------------------------
#define BLIND_SPOT_THRESHOLD_CM   10    // object closer than this -> buzz
#define US_MAX_RANGE_CM           300   // ignore anything beyond this
#define US_GAP_MS                 40    // settle time between the two sensors

// ---- Hall / speed / distance parameters ------------------------------------
#define WHEEL_CIRCUMFERENCE_MM    2100  // measure your wheel (700x25c ~ 2105 mm)
#define OVERSPEED_KMH             35.0
#define MILESTONE_DISTANCE_M      100.0
#define SPEED_TIMEOUT_MS          1500
#define HALL_DEBOUNCE_MS          15
#define HALL_TRIGGER_EDGE         FALLING

// ---- Haptic cooldowns ------------------------------------------------------
#define BLIND_SPOT_COOLDOWN_MS    700
#define OVERSPEED_COOLDOWN_MS     100

// ---- Debug -----------------------------------------------------------------
#define DEBUG_PRINT_MS            500   // serial status interval (0 = off)

// ============================================================================
// ===================== DRV2605 / TCA9548A SETUP =============================
// ============================================================================

// ── PER-MOTOR PWM (the fix for "both motors buzz") ──────────────────────────
// Each driver now has its OWN dedicated PWM line, both generated by Timer2:
//     LEFT  motor  →  pin 11  =  OC2A  =  OCR2A
//     RIGHT motor  →  pin 3   =  OC2B  =  OCR2B   (you moved this one here)
// If your sides turn out reversed, just swap these two lines:
#define LEFT_PWM   OCR2A    // pin 11
#define RIGHT_PWM  OCR2B    // pin 3

// This haptic library drives the DRV2605 in a *signed* PWM scheme:
//   pulse() uses duty 140..255  (above mid = push toward closed end)
//   hit()   uses duty 110..0    (below mid = push toward open end)
// So the "do nothing" value is mid-scale (~50% duty), NOT zero. We hold the
// inactive motor at this neutral level so it produces no drive at all,
// independent of the I²C standby state.
#define PWM_NEUTRAL  127

byte DRV = 0x5A;            // DRV2605 I²C address
byte ModeReg = 0x01;
byte TCA = 0x70;            // TCA9548A I²C mux address

int motor1 = 1;             // LEFT  motor  →  mux channel 1
int motor2 = 2;             // RIGHT motor  →  mux channel 2

// Which motor(s) the current haptic effect should drive.
enum HapticTarget { TGT_LEFT, TGT_RIGHT, TGT_BOTH };
volatile HapticTarget g_target = TGT_LEFT;

// Writes the drive value to the targeted motor and parks the other at neutral.
// This is what makes left/right independent now that the PWM lines are split.
inline void setHaptic(int v) {
  switch (g_target) {
    case TGT_LEFT:  LEFT_PWM  = v;           RIGHT_PWM = PWM_NEUTRAL; break;
    case TGT_RIGHT: RIGHT_PWM = v;           LEFT_PWM  = PWM_NEUTRAL; break;
    case TGT_BOTH:  LEFT_PWM  = v;           RIGHT_PWM = v;           break;
  }
}

// Select target + route the I²C mux so the standby/brake commands inside
// pulse()/hit()/pause() reach the matching DRV(s).
void useLeft()  { g_target = TGT_LEFT;  TCA9548A(motor1); }
void useRight() { g_target = TGT_RIGHT; TCA9548A(motor2); }
void useBoth()  { g_target = TGT_BOTH;  selectBothMotors(); }

// ============================================================================
// ======================= HALL INTERRUPT STATE ===============================
// ============================================================================
volatile unsigned long g_tickCount      = 0;
volatile unsigned long g_lastTickUs     = 0;
volatile unsigned long g_lastIntervalUs = 0;
volatile bool          g_primed         = false;

const unsigned long HALL_DEBOUNCE_US = (unsigned long)HALL_DEBOUNCE_MS * 1000UL;
const unsigned long SPEED_TIMEOUT_US = (unsigned long)SPEED_TIMEOUT_MS * 1000UL;

void hallISR() {
  unsigned long now = micros();
  unsigned long dt  = now - g_lastTickUs;
  if (dt >= HALL_DEBOUNCE_US) {
    if (g_primed) g_lastIntervalUs = dt;
    g_lastTickUs = now;
    g_tickCount++;
    g_primed = true;
  }
}

// ============================================================================
// ===================== ULTRASONIC NON-BLOCKING SM ===========================
// ============================================================================
const uint8_t US_TRIG[2] = { LEFT_TRIG_PIN,  RIGHT_TRIG_PIN };
const uint8_t US_ECHO[2] = { LEFT_ECHO_PIN,  RIGHT_ECHO_PIN };

enum UsState { US_IDLE, US_WAIT_RISE, US_WAIT_FALL, US_GAP };
UsState       usState         = US_IDLE;
uint8_t       usCurrent       = 0;
unsigned long usStateStartUs  = 0;
unsigned long usEchoStartUs   = 0;
unsigned int  usDistanceCm[2] = { 0, 0 };
bool          usNewReading[2] = { false, false };

const unsigned long US_RISE_TIMEOUT_US = 6000UL;
const unsigned long US_MAX_ECHO_US     = (unsigned long)US_MAX_RANGE_CM * 58UL;
const unsigned long US_GAP_US          = (unsigned long)US_GAP_MS * 1000UL;

// ============================================================================
// ===================== ALERT / COOLDOWN STATE ===============================
// ============================================================================
unsigned long lastBuzzMs[2]    = { 0, 0 };
unsigned long lastOverspeedMs  = 0;
unsigned long lastMilestoneNum = 0;
unsigned long lastDebugMs      = 0;

// ============================================================================
// ================================ SETUP =====================================
// ============================================================================
void setup() {
  Wire.begin();
  Serial.begin(9600);
  pwm11configure();     // replaces pwm613configure() — uses Timer2, pin 11

  // --- Initialise both DRV2605 drivers ---
  useLeft();            // target LEFT + route mux to channel 1
  delay(2);
  initializeDRV2605();
  delay(10);
  pulse(0.1, 10);       // "I'm alive" tick on LEFT only

  useRight();           // target RIGHT + route mux to channel 2
  delay(2);
  initializeDRV2605();
  delay(10);
  pulse(0.1, 10);       // "I'm alive" tick on RIGHT only

  // --- Ultrasonic pins ---
  for (uint8_t i = 0; i < 2; i++) {
    pinMode(US_TRIG[i], OUTPUT);
    pinMode(US_ECHO[i], INPUT);
    digitalWrite(US_TRIG[i], LOW);
  }

  // --- Hall sensor (hardware interrupt) ---
  pinMode(HALL_PIN, INPUT_PULLUP);
  attachInterrupt(digitalPinToInterrupt(HALL_PIN), hallISR, HALL_TRIGGER_EDGE);

  Serial.println(F("Bike haptic system ready (Uno build)."));
}

// ============================================================================
// ================================= LOOP =====================================
// ============================================================================
void loop() {
  updateUltrasonic();
  checkHallAlerts();
  checkBlindSpots();
  debugStatus();
}

// ============================================================================
// =================== ULTRASONIC: NON-BLOCKING PINGING =======================
// ============================================================================
void updateUltrasonic() {
  unsigned long now = micros();

  switch (usState) {

    case US_IDLE: {
      uint8_t t = US_TRIG[usCurrent];
      digitalWrite(t, LOW);
      delayMicroseconds(2);
      digitalWrite(t, HIGH);
      delayMicroseconds(10);
      digitalWrite(t, LOW);
      usStateStartUs = micros();
      usState = US_WAIT_RISE;
      break;
    }

    case US_WAIT_RISE: {
      if (digitalRead(US_ECHO[usCurrent]) == HIGH) {
        usEchoStartUs = now;
        usState = US_WAIT_FALL;
      } else if (now - usStateStartUs > US_RISE_TIMEOUT_US) {
        finishReading(0);
      }
      break;
    }

    case US_WAIT_FALL: {
      if (digitalRead(US_ECHO[usCurrent]) == LOW) {
        unsigned long durUs = now - usEchoStartUs;
        finishReading((unsigned int)(durUs / 58UL));
      } else if (now - usEchoStartUs > US_MAX_ECHO_US) {
        finishReading(0);
      }
      break;
    }

    case US_GAP: {
      if (now - usStateStartUs > US_GAP_US) {
        usCurrent ^= 1;
        usState = US_IDLE;
      }
      break;
    }
  }
}

void finishReading(unsigned int cm) {
  usDistanceCm[usCurrent] = cm;
  usNewReading[usCurrent] = true;
  usStateStartUs = micros();
  usState = US_GAP;
}

// ============================================================================
// ===================== BLIND-SPOT DECISION LOGIC ============================
// ============================================================================
void checkBlindSpots() {
  for (uint8_t side = 0; side < 2; side++) {
    if (!usNewReading[side]) continue;
    usNewReading[side] = false;

    unsigned int d = usDistanceCm[side];
    bool object = (d > 0 && d <= BLIND_SPOT_THRESHOLD_CM);

    if (object && (millis() - lastBuzzMs[side] >= BLIND_SPOT_COOLDOWN_MS)) {
      lastBuzzMs[side] = millis();
      if (side == 0) buzzLeft(d);
      else           buzzRight(d);
    }
  }
}

// ============================================================================
// ===================== SPEED + DISTANCE (HALL) ==============================
// ============================================================================
float computeSpeedKmh() {
  noInterrupts();
  unsigned long interval = g_lastIntervalUs;
  unsigned long lastUs   = g_lastTickUs;
  interrupts();

  if (interval == 0) return 0.0;
  if (micros() - lastUs > SPEED_TIMEOUT_US) return 0.0;

  float metresPerRev = WHEEL_CIRCUMFERENCE_MM / 1000.0;
  float seconds      = interval / 1000000.0;
  return (metresPerRev / seconds) * 3.6;
}

float totalDistanceM() {
  noInterrupts();
  unsigned long ticks = g_tickCount;
  interrupts();
  return ticks * (WHEEL_CIRCUMFERENCE_MM / 1000.0);
}

void checkHallAlerts() {
  float speed    = computeSpeedKmh();
  float distance = totalDistanceM();

  if (speed > OVERSPEED_KMH &&
      (millis() - lastOverspeedMs >= OVERSPEED_COOLDOWN_MS)) {
    lastOverspeedMs = millis();
    overspeedAlert();
  }

  unsigned long milestoneNum = (unsigned long)(distance / MILESTONE_DISTANCE_M);
  if (milestoneNum > lastMilestoneNum) {
    lastMilestoneNum = milestoneNum;
    milestoneAlert();
  }
}

// ============================================================================
// ============================ DEBUG OUTPUT ==================================
// ============================================================================
void debugStatus() {
#if DEBUG_PRINT_MS > 0
  if (millis() - lastDebugMs < DEBUG_PRINT_MS) return;
  lastDebugMs = millis();
  Serial.print(F("L="));    Serial.print(usDistanceCm[0]);
  Serial.print(F("cm R=")); Serial.print(usDistanceCm[1]);
  Serial.print(F("cm  v=")); Serial.print(computeSpeedKmh(), 1);
  Serial.print(F("km/h  d=")); Serial.print(totalDistanceM(), 1);
  Serial.println(F("m"));
#endif
}

// ============================================================================
// ============================ ALERT HAPTICS =================================
// ============================================================================
void buzzLeft(unsigned int cm) {
  Serial.print(F("Blind spot LEFT  @ ")); Serial.print(cm); Serial.println(F("cm"));
  useLeft();
  blindSpotPattern();
}

void buzzRight(unsigned int cm) {
  Serial.print(F("Blind spot RIGHT @ ")); Serial.print(cm); Serial.println(F("cm"));
  useRight();
  blindSpotPattern();
}

void blindSpotPattern() {
  vibrate(50, 0.9, 0.12, 33);
  pause(40);
  vibrate(50, 0.9, 0.12, 33);
}

void overspeedAlert() {
  Serial.println(F("** OVERSPEED ** both motors"));
  useBoth();
  for (int i = 0; i < 3; i++) {
    pulse(1, 8);
    pause(60);
  }
}

void milestoneAlert() {
  Serial.println(F("** MILESTONE ** both motors"));
  useBoth();
  vibrate(40, 0.6, 0.12, 30);
  vibrate(90, 0.8, 0.12, 38);
}

void selectBothMotors() {
  Wire.beginTransmission(TCA);
  Wire.write((1 << motor1) | (1 << motor2));
  Wire.endTransmission();
}

// ============================================================================
// ============================================================================
// ===  TACHAMMER / DRV LIBRARY  (logic unchanged; only PWM register changed) ===
// ============================================================================
// ============================================================================

// ---- Basic primitives -------------------------------------------------------

void pulse(double intensity, double milliseconds) {
  int minimumint  = 140;
  int maximumint  = 255;
  int pwmintensity = (intensity * (maximumint - minimumint)) + minimumint;
  standbyOffB();
  setHaptic(pwmintensity);     // drive the targeted motor only
  usdelay(milliseconds);
  standbyOnB();
}

void singlePulse(double intensity, double milliseconds) {
  pulse(intensity, milliseconds);
  pause(3);
  pulse(intensity * 3 / 100, milliseconds * 2);
}

void hit(double intensity, double milliseconds) {
  int minimumint  = 0;
  int maximumint  = 110;
  int pwmintensity = maximumint - (intensity * (maximumint - minimumint));
  standbyOffB();
  setHaptic(pwmintensity);     // drive the targeted motor only
  usdelay(milliseconds);
  standbyOnB();
}

void pause(double milliseconds) {
  double us = milliseconds - ((int)milliseconds);
  standbyOnB();
  for (int i = 0; i <= milliseconds; i++) {
    delay(1);
  }
  delayMicroseconds(us * 1000);
}

void usdelay(double time) {
  double us = time - ((int)time);
  for (int i = 0; i <= time; i++) {
    delay(1);
  }
  delayMicroseconds(us * 1000);
}

void vibrate(double frequency, double intensity, double duration, int dutycycle) {
  int max_hit   = 12;
  int min_hit   = 1;
  int crossover = 60;
  int hitduration = 10 * dutycycle / frequency;

  boolean hold = false;
  double delayy    = (1 / frequency * 1000) - hitduration;
  double timedown  = duration * 1000;

  if (duration == 0) hold = true;

  while (hold) {
    pulse(intensity, hitduration);
    pause(delayy);
  }

  while (timedown >= 0 && frequency < crossover) {
    pulse(intensity, hitduration);
    pause(3);
    pulse(0.002, delayy - 3);
    timedown -= (delayy + hitduration);
  }

  while (timedown >= 0 && frequency >= crossover) {
    pulse(intensity, hitduration);
    pause(delayy);
    timedown -= (delayy + hitduration);
  }
}

// ---- Haptic effects (unchanged) --------------------------------------------

void impactClick() {
  Serial.println("impact click");
  pulse(1, 6);
  hit(1, 21);
}

void ermRumble() {
  Serial.println("ERM Rumble");
  vibrate(30, 0.7, 0.33, 30);
}

void lraClick() {
  Serial.println("LRA Click");
  vibrate(250, 1, 0.01, 70);
}

void heartbeat() {
  Serial.println("Heartbeat");
  int hrate = 0;
  for (int i = 0; i < 16; i++) {
    pulse(0.3, 45);
    pause(12);
    pulse(0.3, 3);
    pause(250 - hrate);
    pulse(0.1, 45);
    pause(12);
    pulse(0.3, 3);
    pause(510 - hrate);
    if (hrate < 200) hrate += 15;
  }
}

void laser() {
  Serial.print("Laser Charging");
  vibrate(35,  0.007, 0.07, 50);
  vibrate(40,  0.008, 0.04, 50);
  vibrate(45,  0.009, 0.04, 50);
  vibrate(60,  0.01,  0.04, 50);
  vibrate(75,  0.03,  0.04, 50);
  vibrate(80,  0.08,  0.04, 50);
  vibrate(85,  0.1,   0.04, 50);
  vibrate(88,  0.1,   0.04, 50);
  vibrate(90,  0.15,  0.04, 50);
  vibrate(130, 0.15,  0.04, 50);
  vibrate(140, 0.2,   0.04, 50);
  vibrate(160, 0.2,   0.04, 50);
  vibrate(200, 0.3,   0.05, 50);
  for (int i = 0; i < 4; i++) {
    vibrate(200, 0.5, 0.01, 50); pulse(.1,  2);
    vibrate(200, 0.5, 0.01, 50); pulse(.7,  2);
    vibrate(200, 0.5, 0.01, 50); pulse(.95, 2);
    vibrate(200, 0.5, 0.01, 50); pulse(.7,  2);
    vibrate(200, 0.5, 0.01, 50); pulse(.1,  2);
  }
}

void laserRelease() {
  Serial.println("Laser Firing");
  hit(0.5, 3);
  pulse(1, 10);
  pause(2);
  pulse(0.002, 5);
  vibrate(160, 0.8, 0.02, 50);
  vibrate(150, 0.5, 0.02, 50);
  vibrate(130, 0.3, 0.03, 50);
  vibrate(120, 0.1, 0.05, 50);
}

void rifle(bool audible) {
  if (audible) {
    Serial.println("Loud Rifle");
    pause(20);
    pulse(1, 6);
    hit(1, 21);
  } else {
    Serial.println("Quiet Rifle");
    hit(1, 3);
    pulse(1, 21);
    pause(2);
    pulse(0.002, 21);
  }
}

void shotgun(bool audible, bool reload) {
  if (!reload) {
    if (audible) {
      Serial.print("Loud Shotgun Firing");
      pulse(1, 6);
      hit(1, 21);
      pause(250);
    } else {
      Serial.print("Quiet Shotgun Firing");
      hit(1, 3);
      singlePulse(1, 21);
      pause(200);
    }
  } else {
    if (audible) {
      Serial.println("Loud Shotgun Reloading");
      pulse(.5, 30);
      hit(.35, 10);
      pause(180);
      hit(.37, 17);
    } else {
      Serial.println("Quiet Shotgun Reloading");
      pulse(.3, 30);
      pulse(.55, 30);
      pause(2.8);
      pulse(0.03, 60);
      pause(115);
      pulse(.55, 30);
      pause(3);
      pulse(0.03, 60);
    }
  }
}

// ---- Test functions (unchanged) --------------------------------------------

void vibrateRamp() {
  double i = 0;
  for (int j = 0; j < 20; j++) {
    Serial.print("Vibrate Frequency: "); Serial.println(250 - i);
    vibrate(200 - i, 0.7, 0.2, 70);
    if (i < 210) i += 10;
  }
}

void pulseRamp() {
  double i = 0;
  for (int j = 0; j < 20; j++) {
    Serial.print("Pulse Intensity: "); Serial.println(i);
    singlePulse(i, 8);
    pause(84);
    if (i < 0.99) i += 0.05;
  }
}

void hitRamp() {
  double i = 0;
  for (int j = 0; j < 20; j++) {
    Serial.print("Hit Intensity: "); Serial.println(i);
    pulse(i, 6);
    hit(i, 21);
    pause(100);
    if (i < 0.99) i += 0.05;
  }
}

void effectCycle(int count) {
  Serial.println(count);
  if      (count == 0)  { for (int j=0;j<4;j++) { lraClick();   pause(500); } pause(1000); }
  else if (count == 1)  { for (int j=0;j<4;j++) { ermRumble(); }              pause(1000); }
  else if (count == 2)  { vibrateRamp();                                       pause(1000); }
  else if (count == 3)  { for (int j=0;j<4;j++) { impactClick(); pause(500); } pause(1000); }
  else if (count == 4)  { for (int j=0;j<20;j++) rifle(1);                    pause(1000); }
  else if (count == 5)  { for (int j=0;j<20;j++) rifle(0);                    pause(1000); }
  else if (count == 6)  { for (int j=0;j<4;j++) { shotgun(1,0); shotgun(1,1); pause(500); } pause(1000); }
  else if (count == 7)  { for (int j=0;j<4;j++) { shotgun(0,0); shotgun(0,1); pause(500); } pause(1000); }
  else if (count == 8)  { laser(); laserRelease();                             pause(1000); }
  else if (count == 9)  { heartbeat();                                         pause(1000); }
  else if (count == 10) { hitRamp();                                           pause(1000); }
  else if (count == 11) { pulseRamp();                                         pause(1000); }
  else if (count >= 11) { count = 0; }
}

// ============================================================================
// =============================== DRV SETUP ==================================
// ============================================================================

void standbyOnB() {
  Wire.beginTransmission(DRV);
  Wire.write(ModeReg);
  Wire.write(0x43);   // PWM mode + standby
  Wire.endTransmission();
}

void standbyOffB() {
  Wire.beginTransmission(DRV);
  Wire.write(ModeReg);
  Wire.write(0x03);   // PWM mode, active
  Wire.endTransmission();
}

void initializeDRV2605() {
  Wire.beginTransmission(DRV);
  Wire.write(ModeReg);
  Wire.write(0x00);   // clear standby
  Wire.endTransmission();

  Wire.beginTransmission(DRV);
  Wire.write(0x1D);
  Wire.write(0xA8);   // RTP unsigned
  Wire.endTransmission();

  Wire.beginTransmission(DRV);
  Wire.write(0x03);
  Wire.write(0x02);   // Library B
  Wire.endTransmission();

  Wire.beginTransmission(DRV);
  Wire.write(0x17);
  Wire.write(0xff);   // full-scale reference
  Wire.endTransmission();

  Wire.beginTransmission(DRV);
  Wire.write(ModeReg);
  Wire.write(0x03);   // PWM mode
  Wire.endTransmission();

  delay(100);
}

// ============================================================================
// ========================= PWM SETUP  (Timer2: pins 11 + 3) =================
// ============================================================================
// Two independent PWM outputs from ONE timer:
//   OC2A = pin 11 = OCR2A  → LEFT  driver
//   OC2B = pin 3  = OCR2B  → RIGHT driver
// Same frequency, separate duty registers, so each motor is driven on its own
// wire. Prescaler /8, TOP = 255  →  16 MHz / 8 / 256 ≈ 7.8 kHz (DRV2605 OK).
// Both start at PWM_NEUTRAL (~50% duty = no drive).
// ============================================================================
void pwm11configure() {
  DDRB |= _BV(3);   // pin 11 (OC2A, PB3) as output
  DDRD |= _BV(3);   // pin 3  (OC2B, PD3) as output

  // WGM2[2:0] = 011  → Fast PWM, TOP = 0xFF
  // COM2A/COM2B = 10 → non-inverting on both channels
  TCCR2A = _BV(COM2A1) | _BV(COM2B1) | _BV(WGM21) | _BV(WGM20);

  // CS2[2:0] = 010   → prescaler /8  → ~7.8 kHz
  TCCR2B = _BV(CS21);

  OCR2A = PWM_NEUTRAL;   // both motors idle (no drive)
  OCR2B = PWM_NEUTRAL;
}

void TCA9548A(uint8_t bus) {
  Wire.beginTransmission(TCA);
  Wire.write(1 << bus);
  Wire.endTransmission();
}
